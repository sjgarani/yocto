## build/conf/bblayers.conf
```bitbake
# POKY_BBLAYERS_CONF_VERSION is increased each time build/conf/bblayers.conf
# changes incompatibly
POKY_BBLAYERS_CONF_VERSION = "2"

BBPATH = "${TOPDIR}"
BBFILES ?= ""

BBLAYERS ?= " \
  ${TOPDIR}/../poky/meta \
  ${TOPDIR}/../poky/meta-poky \
  ${TOPDIR}/../poky/meta-yocto-bsp \
  ${TOPDIR}/../metas/meta-openembedded/meta-oe \
  ${TOPDIR}/../metas/meta-openembedded/meta-python \
  ${TOPDIR}/../metas/meta-openembedded/meta-multimedia \
  ${TOPDIR}/../metas/meta-openembedded/meta-networking \
  ${TOPDIR}/../metas/meta-erlang \
  ${TOPDIR}/../metas/meta-devon \
  /home/sgarani/Workspace/yocto/build/workspace \
  "
```
